
RealMain = 0x005B4BBE; /*WinMain*/
_ZN3ASL11mAppCmdLineE = 0x01FEE000;

_ZN12cRZDirectory29MakeSurePathEndsWithSeparatorEv = 0x0050AB72;
_ZN12cRZDirectory20ReadDirectoryEntriesEv = 0x0050BA40;

_ZNK9cRZString9CompareToERK10cIGZStringb = 0x00530988;
_ZNK9cRZString9CompareToEPKcjb = 0x00530A2A;
_ZN9cRZString7SprintfEPKcz = 0x0053057A;
_ZN9cRZString13SprintfVaListEPKcPc = 0x005305E4;

_ZN9cRZStringD1Ev = 0x005315DA;
_ZTV9cRZString = 0x01EF7200;

gMainHWND = 0x01CE1478;

_Z21ConvertStringEncodingPKvmlPvRml = 0x0053CF4E;

_ZN9cRZThreadC2Ev = 0x00533882;
_ZN9cRZThreadC1Ev = 0x005338D4;

_ZN16cTSPersistSystem18ForceOpenResourcesEPv = 0x007D06BC;

sLastError = 0x00032A37;

_ZN9cRZThread13SetThreadNameEPc = 0x005336F4;

_ZN3ASL22mNeedsUnicodeTextInputE = 0x01CE16DC;

SECTIONS
{
    . = 0x04000000;
}